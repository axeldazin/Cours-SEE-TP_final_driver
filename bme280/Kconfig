## bme280/Kconfig
```kconfig
menuconfig MY_SENSOR
    bool "Capteur de temperature bosh bme 280"

    default y
    depends on SENSOR && I2C
    depends on DT_HAS_BOCSH_BME280_ENABLED
    select SENSOR_ASYNC_API

    help
      Active le driver I2C du BME280 utilisant Read and Decode
      pour la temperature, la pression et lhumidite.
```

## bme280/dts/bindings/sensor/bosh,my_bme280.yaml
```yaml
description: Capteur de temperature simule pour un TP
compatible: "bocsh,bme280"
include: [sensor-device.yaml,i2c-device.yaml]

properties:
```

## dummy_driver/Kconfig
```kconfig
menuconfig MY_SENSOR
    bool "Capteur de temperature simulé"

    default y
    depends on DT_HAS_ZEPHYR_TP_SENSOR_ENABLED
    select SENSOR_ASYNC_API

    help
      Active le driver du capteur simule utilisant Read and Decode.

if MY_SENSOR

config MY_SENSOR_STEP_MC
    int "Increment de temperature en millicelsius"
    range 0 10000
    default 250
    help
      Increment applique entre deux lectures.
      Utiliser 0 pour obtenir une temperature constante.

endif
```

## dummy_driver/dts/bindings/sensor/zephyr,tp-sensor.yaml
```yaml
description: Capteur de temperature simule pour un TP
compatible: "zephyr,tp-sensor"
include: [sensor-device.yaml]

properties:
  initial-millicelsius:
    type: int
    default: 0
    description: | 
      initial value of millicelsius

  maximum-millicelsius:
    type: int
    default: 0
    description: | 
      maximum value of millicelsius
```
